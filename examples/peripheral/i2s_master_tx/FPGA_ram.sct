; *************************************************************
; *** Scatter-Loading Description File generated by uVision ***
; *************************************************************

SOC 0x20000000 0x18000  ; 96KB
{
    STARTUP + 0
    {
        *(VECTOR_IN_EFLASH, +First)
        *(InRoot$$Sections)
    }

;    BLE_JUMP_TABLE 0x20000200 FIXED 0x400
;    {
;        .ANY (jump_table_mem_area)
;    }

    IMAGE_RO + 0
    {
        ;*(RO_IN_SYS_RAM)
        * (+RO)
    }

    IMAGE_RW + 0
    {
        ;*(RW_IN_SYS_RAM)
        ;clock.o (+RO, +RW, +ZI)
        * (+RW)
    }

    IMAGE_ZI + 0
    {
        ;*(ZI_IN_SYS_RAM)
        * (+ZI)
    }

    RAM_START + 0
    {
        .ANY (+RO, +RW, +ZI)
    }

    RAM_END 0x20018000 EMPTY -0x4
    {

    }

    RET_RAM 0x20020000 EMPTY 0x2000 ; Retention memory
    {
        ;*(VECTOR_IN_RET_RAM, +First)
        ;*(IN_RET_RAM)
        ;jump_table.o (heap_env_area)
        ;jump_table.o (heap_db_area)
        ;jump_table.o (heap_msg_area)
    }

    EX_MEM 0x40060000 EMPTY 0x2000 ; Exchange memory
    {

    }
}


; *************************************************************
; *** Scatter-Loading Description File generated by uVision ***
; *************************************************************

SOC 0x20000000 0x20000  ; 128KB
{
    STARTUP + 0
    {
        *(VECTOR_TABLE, +First)
    }

    HEADER + 0 ;should be start from offset 0x08
    {
        *(IMAGE_HEADER, +First)
        *(InRoot$$Sections)
    }

    BLE_JUMP_TABLE 0x20000200 FIXED 0x400
    {
        .ANY (jump_table_mem_area)
    }

    IMAGE_RO + 0
    {
        ;*(RO_IN_SYS_RAM)
        .ANY (+RO)
    }

    IMAGE_RW + 0
    {
        ;*(RW_IN_SYS_RAM)
        ;clock.o (+RO, +RW, +ZI)
        .ANY (+RW)
    }

    IMAGE_ZI + 0
    {
        ;*(ZI_IN_SYS_RAM)
        .ANY (+ZI)
    }

    RET_RAM 0x20020000 ; Retention memory
    {
        ;*(VECTOR_IN_RET_RAM, +First)
        ;*(IN_RET_RAM)
        ;jump_table.o (heap_env_area)
        ;jump_table.o (heap_db_area)
        ;jump_table.o (heap_msg_area)
    }

}

